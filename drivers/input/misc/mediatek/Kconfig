## drivers/input/misc/mediatek/Kconfig
```kconfig
# Hall sensors
config INPUT_HALL_SENSOR
	bool "hall sensor support"
	help
	Support for hall sensor.

# Temperature sensors
config INPUT_TEMPERATURE_TMP103
       bool "TMP103 temperature sensor support"
       help
         Support for TI Digital Temperature Sensor TMP103
```

## drivers/misc/mediatek/Kconfig
```kconfig
menuconfig MEDIATEK_SOLUTION
	bool "MediaTek Properitary Configuration"
	select FW_LOADER_USER_HELPER_FALLBACK
	help
	  Check this to enable MediaTek properity configuration.

if MEDIATEK_SOLUTION

config MTK_PLATFORM
	string "MTK platform name"

config ARCH_MTK_PROJECT
	string "MTK project name"

config MTK_LEGACY
	bool "MTK LEGACY driver API support"
	help
	  This is an option for MTK legacy driver that using old API
	  It will be deprecated after all drivers changed to new structure

config MTK_INTERNAL
	bool "Enable MTK internal debug feature"
	help
	  Identify if codebase is built with MTK internal debug
	  (Don't modify this feature option setting.)

config FPGA_EARLY_PORTING
	bool "FPGA_EARLY_PORTING"
	help
	   Used for FPGA early porting to separate code segments between FPGA
	   platform and non-FPGA platform

config MTK_LM_MODE
	bool "MTK Large Memory mode"
	select ARM_LPAE if !ARM64
	select ARCH_PHYS_ADDR_T_64BIT
	select ARCH_DMA_ADDR_T_64BIT
	help
	  Large Memory mode support for supporting more than 4GB DRAM access

config MTK_MEM
	bool "Support platform memory information"
	default y
	help
	  MTK_MEM provides basic platform memory information
	  for mediatek platform drivers. It also provides
	  some debug features. Please see
	  MTK_MEMCFG.

config MTK_MEMCFG
	bool "Support enhanced memory configurations"
	depends on MTK_MEM
	default n
	help
	  MTK_MEMCFG provides debug features such as
	  platform memory layout information and
	  fragmentation test tools. The features
	  cost additional memory.

config MTK_MEMORY_LOWPOWER
	bool "Support Mediatek memory lowpower technology"
	default n
	help
	  Mediatek DRAM low power technology.
	  It tries to safe DRAM power by switching
	  different DRAM mode dynamically. It's a
	  platform-dependent feature.

config MTK_BASE_POWER
	bool

config MTK_SHARED_SDCARD
	bool "MTK_SHARED_SDCARD"
	help
	  sdcard will be a folder of /data

config MTK_SENSOR_SUPPORT
	bool "MTK_SENSOR_SUPPORT"
	help
	  sensor config to sensor port sensor feature in project.

config CUSTOM_KERNEL_IMGSENSOR
	string "CUSTOM_KERNEL_IMGSENSOR"
	help
	  Kernel space image sensor driver. Define  project used all image
	  sensors .The value is combination of CUSTOM_KERNEL_MAIN_IMGSENSOR,
	  CUSTOM_KERNEL_MAIN_BACKUP_IMGSENSOR, CUSTOM_KERNEL_SUB_IMGSENSOR,
	  and CUSTOM_KERNEL_SUB_BACKUP_IMGSENSOR

config MTK_SEC_VIDEO_PATH_SUPPORT
	bool "Enable MTK Secure Video Path Support"
	depends on (MTK_IN_HOUSE_TEE_SUPPORT) || (TRUSTONIC_TEE_SUPPORT) || (TRUSTY)
	default n
	help
	  This enable MTK Secure Video Path Support. (depending on
	  MTK In-House TEE Support or Trustonic TEE Support)

config MTK_DRM_KEY_MNG_SUPPORT
	bool "MTK_DRM_KEY_MNG_SUPPORT"
	depends on (MTK_IN_HOUSE_TEE_SUPPORT) || (TRUSTONIC_TEE_SUPPORT) || (TRUSTY)
	default n
	help
	  This enable MTK DRM Key Manager Support.
	  depending on GCPU
	  MTK In-House TEE Support
	  or Trustonic TEE Support.

config MTK_LDVT
	bool "LDVT"
	default n
	help
	  Support LDVT or not

config MTK_LCM_PHYSICAL_ROTATION_HW
	bool "MTK_LCM_PHYSICAL_ROTATION_HW"
	default n
	help
	  Rotate LCM display for 180 degree using mediatek hardware engine
	  Enable it when LCM hardware is intalled upside down,
	  and you need to rotate the display content to adapting.

source "drivers/misc/mediatek/gpt/Kconfig"
source "drivers/misc/mediatek/uart/Kconfig"
source "drivers/misc/mediatek/auxadc/Kconfig"
source "drivers/misc/mediatek/videocodec/Kconfig"
source "drivers/misc/mediatek/m4u/Kconfig"
source "drivers/misc/mediatek/jpeg/Kconfig"
source "drivers/misc/mediatek/power/Kconfig"
source "drivers/misc/mediatek/pmic_wrap/Kconfig"
source "drivers/misc/mediatek/cmdq/Kconfig"
source "drivers/misc/mediatek/smi/Kconfig"
source "drivers/misc/mediatek/base/power/Kconfig"
source "drivers/misc/mediatek/boot/Kconfig"
source "drivers/misc/mediatek/boot_reason/Kconfig"
source "drivers/misc/mediatek/chip/Kconfig"
source "drivers/misc/mediatek/devinfo/Kconfig"
source "drivers/misc/mediatek/gpu/Kconfig"
source "drivers/misc/mediatek/mmp/Kconfig"
source "drivers/misc/mediatek/lcm/Kconfig"
source "drivers/misc/mediatek/video/Kconfig"
source "drivers/misc/mediatek/dramc/Kconfig"
source "drivers/misc/mediatek/sync/Kconfig"
 
source "drivers/misc/mediatek/pwm/Kconfig"
source "drivers/misc/mediatek/accelerometer/Kconfig"
source "drivers/misc/mediatek/alsps/Kconfig"
source "drivers/misc/mediatek/hwmon/Kconfig"
source "drivers/misc/mediatek/gud/Kconfig"
source "drivers/misc/mediatek/freqhopping/Kconfig"
source "drivers/misc/mediatek/cirq/Kconfig"
source "drivers/misc/mediatek/accdet/Kconfig"
source "drivers/misc/mediatek/masp/Kconfig"
source "drivers/misc/mediatek/debug_latch/Kconfig"
source "drivers/misc/mediatek/systracker/Kconfig"
source "drivers/misc/mediatek/ram_console/Kconfig"
source "drivers/misc/mediatek/xlog/Kconfig"
 
source "drivers/misc/mediatek/sched/Kconfig"
source "drivers/misc/mediatek/dynamic_boost/Kconfig"
source "drivers/misc/mediatek/trustzone/Kconfig"
source "drivers/misc/mediatek/imgsensor/Kconfig"
source "drivers/misc/mediatek/connectivity/Kconfig"
source "drivers/misc/mediatek/conn_md/Kconfig"
source "drivers/misc/mediatek/flashlight/Kconfig"
source "drivers/misc/mediatek/thermal/Kconfig"
source "drivers/misc/mediatek/rtc/Kconfig"
source "drivers/misc/mediatek/ssusb/Kconfig"
source "drivers/misc/mediatek/mlog/Kconfig"
source "drivers/misc/mediatek/emi_bwl/Kconfig"
source "drivers/misc/mediatek/emi_mpu/Kconfig"
source "drivers/misc/mediatek/md32/Kconfig"
source "drivers/misc/mediatek/emi_mbw/Kconfig"
 
source "drivers/misc/mediatek/ice_debug/Kconfig"
source "drivers/misc/mediatek/performance/Kconfig"
source "drivers/misc/mediatek/ext_gic/Kconfig"
 
source "drivers/misc/mediatek/selinux_warning/Kconfig"
source "drivers/misc/mediatek/etm/Kconfig"
source "drivers/misc/mediatek/met/Kconfig"
endif
```
